## Config.in
```kconfig
source "$BR2_EXTERNAL_FREEMIGA_PATH/package/amiberry/Config.in"
source "$BR2_EXTERNAL_FREEMIGA_PATH/package/lhasa/Config.in.host"
source "$BR2_EXTERNAL_FREEMIGA_PATH/package/aros/Config.in"
source "$BR2_EXTERNAL_FREEMIGA_PATH/package/whdload/Config.in"
source "$BR2_EXTERNAL_FREEMIGA_PATH/package/cracktros/Config.in"
```

## configs/raspberrypi4_64_defconfig
```kconfig
BR2_aarch64=y
BR2_cortex_a72=y
BR2_ARM_FPU_VFPV4=y
BR2_CCACHE=y
BR2_GLOBAL_PATCH_DIR="$(BR2_EXTERNAL)/board/raspberrypi4/patches"
BR2_TOOLCHAIN_BUILDROOT_GLIBC=y
BR2_PACKAGE_HOST_LINUX_HEADERS_CUSTOM_5_4=y
BR2_TOOLCHAIN_BUILDROOT_CXX=y
BR2_TARGET_GENERIC_HOSTNAME="host"
BR2_TARGET_GENERIC_ISSUE="Welcome to FreeMIGA"
BR2_ROOTFS_DEVICE_CREATION_DYNAMIC_EUDEV=y
BR2_TARGET_GENERIC_ROOT_PASSWD="freemiga"
BR2_TARGET_GENERIC_GETTY_TERM="linux"
BR2_SYSTEM_DHCP="eth0"
BR2_ROOTFS_USERS_TABLES="$(BR2_EXTERNAL)/board/raspberrypi4/users_table.txt"
BR2_ROOTFS_OVERLAY="$(BR2_EXTERNAL)/board/raspberrypi4/rootfs_overlay"
BR2_ROOTFS_POST_BUILD_SCRIPT="$(BR2_EXTERNAL)/board/raspberrypi4/post-build.sh"
BR2_ROOTFS_POST_IMAGE_SCRIPT="$(BR2_EXTERNAL)/board/raspberrypi4/post-image.sh"
BR2_ROOTFS_POST_SCRIPT_ARGS="--add-miniuart-bt-overlay --aarch64"
BR2_LINUX_KERNEL=y
BR2_LINUX_KERNEL_CUSTOM_TARBALL=y
BR2_LINUX_KERNEL_CUSTOM_TARBALL_LOCATION="$(call github,raspberrypi,linux,ff93994fb3f92070d8521d709ad04675ecaa5817)/linux-ff93994fb3f92070d8521d709ad04675ecaa5817.tar.gz"
BR2_LINUX_KERNEL_DEFCONFIG="bcm2711"
BR2_LINUX_KERNEL_DTS_SUPPORT=y
BR2_LINUX_KERNEL_INTREE_DTS_NAME="broadcom/bcm2711-rpi-4-b"
BR2_LINUX_KERNEL_NEEDS_HOST_OPENSSL=y
BR2_PACKAGE_ALSA_UTILS=y
BR2_PACKAGE_ALSA_UTILS_ALSACONF=y
BR2_PACKAGE_ALSA_UTILS_APLAY=y
BR2_PACKAGE_AUMIX=y
BR2_PACKAGE_E2FSPROGS=y
BR2_PACKAGE_E2FSPROGS_RESIZE2FS=y
BR2_PACKAGE_KMSCUBE=y
BR2_PACKAGE_MESA3D=y
BR2_PACKAGE_MESA3D_GALLIUM_DRIVER_KMSRO=y
BR2_PACKAGE_MESA3D_GALLIUM_DRIVER_V3D=y
BR2_PACKAGE_MESA3D_GALLIUM_DRIVER_VC4=y
BR2_PACKAGE_MESA3D_OPENGL_ES=y
BR2_PACKAGE_SDL2=y
BR2_PACKAGE_SDL2_KMSDRM=y
BR2_PACKAGE_SDL2_OPENGLES=y
BR2_PACKAGE_SDL2_GFX=y
BR2_PACKAGE_SDL2_IMAGE=y
BR2_PACKAGE_SDL2_MIXER=y
BR2_PACKAGE_SDL2_NET=y
BR2_PACKAGE_SDL2_TTF=y
BR2_PACKAGE_RPI_FIRMWARE=y
BR2_PACKAGE_RPI_FIRMWARE_VARIANT_PI4=y
BR2_PACKAGE_RPI_WIFI_FIRMWARE=y
BR2_PACKAGE_EVTEST=y
BR2_PACKAGE_LIBPNG=y
BR2_PACKAGE_LIBXML2=y
BR2_PACKAGE_NCURSES_WCHAR=y
BR2_PACKAGE_NCURSES_TARGET_PROGS=y
BR2_PACKAGE_IPTABLES=y
BR2_PACKAGE_IW=y
BR2_PACKAGE_OPENSSH=y
BR2_PACKAGE_WPA_SUPPLICANT=y
BR2_PACKAGE_WPA_SUPPLICANT_CLI=y
BR2_PACKAGE_WPA_SUPPLICANT_PASSPHRASE=y
BR2_PACKAGE_UTIL_LINUX_SETTERM=y
BR2_PACKAGE_UTIL_LINUX_SU=y
BR2_PACKAGE_MC=y
BR2_TARGET_ROOTFS_EXT2=y
BR2_TARGET_ROOTFS_EXT2_4=y
BR2_TARGET_ROOTFS_EXT2_SIZE="300M"
# BR2_TARGET_ROOTFS_TAR is not set
BR2_PACKAGE_HOST_DOSFSTOOLS=y
BR2_PACKAGE_HOST_GENIMAGE=y
BR2_PACKAGE_HOST_MTOOLS=y
BR2_PACKAGE_AMIBERRY=y
BR2_PACKAGE_AROS=y
BR2_PACKAGE_WHDLOAD=y
BR2_PACKAGE_CRACKTROS=y
BR2_PACKAGE_AMIGAFONTS=y
```

## package/amiberry/Config.in
```kconfig
config BR2_PACKAGE_AMIBERRY
	bool "Amiberry"
	depends on BR2_PACKAGE_SDL2
	select BR2_PACKAGE_MPG123
	help
	  An Amiga emulator

	  https://github.com/midwan/amiberry

comment "Amiberry depends on SDL"
	depends on !(BR2_PACKAGE_SDL2)
```

## package/amigafonts/Config.in
```kconfig
config BR2_PACKAGE_AMIGAFONTS
	bool "Amigafonts"
	help
	  Multi Platform Amiga Fonts

	  https://github.com/rewtnull/amigafonts
```

## package/aros/Config.in
```kconfig
config BR2_PACKAGE_AROS
	bool "aros"
	depends on BR2_PACKAGE_AMIBERRY
	select BR2_PACKAGE_HOST_XORRISO
	select BR2_PACKAGE_HOST_LHASA

	help
	  The AROS Research Operating System is a lightweight,
	  efficient, and flexible desktop operating system,
	  designed to help you make the most of your computer.
	  It's an independent, portable and free project,
	  aiming at being compatible with AmigaOS at the
	  API level (like Wine, unlike UAE), while improving
	  on it in many areas. The source code is available
	  under an open source license, which allows anyone
	  to freely improve upon it.

	  https://aros.sourceforge.io/

comment "Aros depends on Amiberry"
        depends on !(BR2_PACKAGE_AMIBERRY)
```

## package/cracktros/Config.in
```kconfig
config BR2_PACKAGE_CRACKTROS
	bool "cracktros"
	depends on BR2_PACKAGE_WHDLOAD

	help
	  Short:    Harddisk Installs using WHDLoad
	  Author:   various authors
	  Uploader: wepl@whdload.de (Bert Jahn)
	  Type:     game/patch
	  Requires: dev/misc/WHDLoad_usr.lha
	  This is a snapshot collection (04.01.2021) of HD installs using WHDLoad. For
	  updates and other informations refer to

	  http://www.whdload.de/

comment "cractros needs WHDLoad"
        depends on !(BR2_PACKAGE_WHDLOAD)
```

## package/lhasa/Config.in.host
```kconfig
config BR2_PACKAGE_HOST_LHASA
	bool "host lhasa"
	help
	  Free Software LHA implementation

	  https://github.com/fragglet/lhasa
```

## package/whdload/Config.in
```kconfig
config BR2_PACKAGE_WHDLOAD
	bool "whdload"
	depends on BR2_PACKAGE_AROS

	help
	  A package for HDD installation of Amiga software

	  http://whdload.de/

comment "WHDLoad depends on Aros"
        depends on !(BR2_PACKAGE_AROS)
```
